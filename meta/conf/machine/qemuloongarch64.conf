## meta/conf/machine/qemuloongarch64.conf
```bitbake
#@TYPE: Machine
#@NAME: generic loongarch64 machine
#@DESCRIPTION: Machine configuration for running a generic loongarch64

require conf/machine/include/riscv/qemuloongarch.inc
```
